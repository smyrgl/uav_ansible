/dts-v1/;

/* PWM out on 40-pin header pin 15 (Jetson SODIMM signal GPIO12 / soc_gpio39_pn1).
 *
 * Generated by jetson-io on the target (JetPack 7.2) and committed verbatim as
 * the authoritative, board-matched overlay — do not hand-edit. To regenerate:
 *   sudo /opt/nvidia/jetson-io/jetson-io.py   (Configure 40-pin header)
 * then decompile the produced /boot/jetson-io-hdr40-user-custom.dtbo with
 *   dtc -I dtb -O dts <file>.dtbo
 *
 * Applied via the extlinux OVERLAYS key. The pinmux function for this pin is
 * "gp" (the GP_PWM1 function group); the PWM controllers are already enabled in
 * the base DT, so no &pwm1 status change is needed.
 */
/ {
	jetson-header-name = "Jetson 40pin Header";
	overlay-name = "User Custom [2026-06-24-230850]";
	compatible = "nvidia,p3768-0000+p3767-0000\0nvidia,p3768-0000+p3767-0001\0nvidia,p3768-0000+p3767-0003\0nvidia,p3768-0000+p3767-0004\0nvidia,p3768-0000+p3767-0005\0nvidia,p3768-0000+p3767-0000-super\0nvidia,p3768-0000+p3767-0001-super\0nvidia,p3768-0000+p3767-0003-super\0nvidia,p3768-0000+p3767-0004-super\0nvidia,p3768-0000+p3767-0005-super\0nvidia,p3509-0000+p3767-0000\0nvidia,p3509-0000+p3767-0001\0nvidia,p3509-0000+p3767-0003\0nvidia,p3509-0000+p3767-0004\0nvidia,p3509-0000+p3767-0005";

	fragment@0 {
		target = <0xffffffff>;

		__overlay__ {
			pinctrl-names = "default";
			pinctrl-0 = <0x01>;

			exp-header-pinmux {
				phandle = <0x01>;

				hdr40-pin15 {
					nvidia,gpio-mode = <0x01>;
					nvidia,pins = "soc_gpio39_pn1";
					nvidia,function = "gp";
					nvidia,tristate = <0x00>;
					nvidia,enable-input = <0x00>;
				};
			};
		};
	};

	fragment@1 {
		target = <0xffffffff>;

		__overlay__ {
			pinctrl-names = "default";
			pinctrl-0 = <0x02>;

			exp-header-pinmux {
				phandle = <0x02>;
			};
		};
	};

	__symbols__ {
		jetson_io_pinmux = "/fragment@0/__overlay__/exp-header-pinmux";
		jetson_io_pinmux_aon = "/fragment@1/__overlay__/exp-header-pinmux";
	};

	__fixups__ {
		pinmux = "/fragment@0:target:0";
		pinmux_aon = "/fragment@1:target:0";
	};

	__local_fixups__ {

		fragment@0 {

			__overlay__ {
				pinctrl-0 = <0x00>;
			};
		};

		fragment@1 {

			__overlay__ {
				pinctrl-0 = <0x00>;
			};
		};
	};
};
